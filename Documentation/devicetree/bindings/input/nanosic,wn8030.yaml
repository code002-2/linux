## Documentation/devicetree/bindings/input/nanosic,wn8030.yaml
```yaml
# SPDX-License-Identifier: (GPL-2.0-only OR BSD-2-Clause)
%YAML 1.2
---
$id: http://devicetree.org/schemas/input/nanosic,wn8030.yaml#
$schema: http://devicetree.org/meta-schemas/core.yaml#

title: Nanosic WN8030 keyboard cover MCU

maintainers:
  - bluseliu50 <bluseliu50@gmail.com>

description:
  The WN8030 is an I2C-attached microcontroller that bridges a detachable
  keyboard cover (keyboard, touchpad and their LEDs) to the host over pogo
  pins. It boots from RAM, so the host downloads its firmware through the
  MCU bootloader every time the MCU is powered up or reset. The keyboard
  and touchpad are then exposed as HID devices. The board variant selects
  the report descriptors, the command register and the power-up timing.

properties:
  compatible:
    enum:
      - nanosic,wn8030-piano
      - nanosic,wn8030-sheng

  reg:
    maxItems: 1

  interrupts:
    maxItems: 1
    description: Data-ready line, rising edge.

  reset-gpios:
    maxItems: 1

  sleep-gpios:
    maxItems: 1
    description: Keeps the MCU awake while deasserted.

  status-gpios:
    maxItems: 1
    description: Cover attach status reported by the MCU.

  vddio-supply:
    description: 1.8 V I/O and I2C pull-up supply.

  dvdd-supply:
    description: 3.3 V MCU supply. It is switched on only after vddio.

required:
  - compatible
  - reg
  - interrupts
  - reset-gpios
  - sleep-gpios
  - status-gpios
  - vddio-supply
  - dvdd-supply

additionalProperties: false

examples:
  - |
    #include <dt-bindings/gpio/gpio.h>
    #include <dt-bindings/interrupt-controller/irq.h>

    i2c {
        #address-cells = <1>;
        #size-cells = <0>;

        keyboard@4c {
            compatible = "nanosic,wn8030-piano";
            reg = <0x4c>;
            interrupts-extended = <&tlmm 97 IRQ_TYPE_EDGE_RISING>;
            reset-gpios = <&tlmm 188 GPIO_ACTIVE_LOW>;
            sleep-gpios = <&tlmm 3 GPIO_ACTIVE_LOW>;
            status-gpios = <&tlmm 95 GPIO_ACTIVE_HIGH>;
            vddio-supply = <&vreg_l11b_1p8>;
            dvdd-supply = <&vreg_l14b_3p3>;
        };
    };
...
```

## Documentation/devicetree/bindings/input/touchscreen/novatek,nvt-ts-spi.yaml
```yaml
# SPDX-License-Identifier: (GPL-2.0-only OR BSD-2-Clause)
%YAML 1.2
---
$id: http://devicetree.org/schemas/input/touchscreen/novatek,nvt-ts-spi.yaml#
$schema: http://devicetree.org/meta-schemas/core.yaml#

title: Novatek NT36532E SPI touchscreen controller

maintainers:
  - Xiaomi Pad 8 Pro (piano) mainline contributors

description: |
  Novatek NT36532E "no-flash" touchscreen controller connected over
  SPI. The controller has no internal flash and downloads its firmware
  from the host on every power-up; the firmware blob is requested via
  the firmware-name property. Binding written for the driver ported
  from the Xiaomi sheng (Pad 6S Pro) tree.

allOf:
  - $ref: /schemas/spi/spi-peripheral-props.yaml#

properties:
  compatible:
    const: novatek,NVT-ts-spi

  reg:
    maxItems: 1

  spi-max-frequency: true

  novatek,irq-gpios:
    maxItems: 1
    description: Interrupt GPIO from the touch controller.

  novatek,lcd-id-gpios:
    maxItems: 1
    description: |
      Panel vendor identification input, read once at probe. Its level
      selects the entry of firmware-name to download (Xiaomi piano:
      0 = CSOT panel, 1 = BOE panel).

  novatek,spi-rd-fast-addr:
    $ref: /schemas/types.yaml#/definitions/uint32
    description: |
      Register address written to disable SPI fast-read mode during
      bootloader reset. Optional; fast-read stays enabled when absent.

  firmware-name:
    $ref: /schemas/types.yaml#/definitions/string-array
    minItems: 1
    maxItems: 2
    description: |
      Firmware blob(s) downloaded at boot. With two entries the level of
      novatek,lcd-id-gpios selects one. No firmware is requested when this
      property is absent.

  pinctrl-0: true
  pinctrl-1: true
  pinctrl-names: true

  panel:
    $ref: /schemas/types.yaml#/definitions/phandle
    description: |
      Phandle to the DRM panel this touch controller follows. When present,
      the driver registers as a DRM panel follower and defers probe until
      the panel is prepared. When absent, the panel is assumed to be powered
      by the bootloader (e.g. continuous splash on a simple framebuffer).

required:
  - compatible
  - reg
  - spi-max-frequency
  - novatek,irq-gpios

additionalProperties: false

examples:
  - |
    #include <dt-bindings/gpio/gpio.h>
    spi {
        #address-cells = <1>;
        #size-cells = <0>;

        touchscreen@0 {
            compatible = "novatek,NVT-ts-spi";
            reg = <0>;
            spi-max-frequency = <19200000>;
            novatek,irq-gpios = <&tlmm 162 GPIO_ACTIVE_HIGH>;
            novatek,lcd-id-gpios = <&tlmm 100 GPIO_ACTIVE_HIGH>;
            firmware-name = "novatek/novatek_nt36532_piano_fw_csot.bin",
                            "novatek/novatek_nt36532_piano_fw_boe.bin";
        };
    };
...
```

## Documentation/devicetree/bindings/power/supply/southchip,sc8541.yaml
```yaml
# SPDX-License-Identifier: (GPL-2.0-only OR BSD-2-Clause)
%YAML 1.2
---
$id: http://devicetree.org/schemas/power/supply/southchip,sc8541.yaml#
$schema: http://devicetree.org/meta-schemas/core.yaml#

title: Southchip SC8541 switched-capacitor direct charger

maintainers:
  - bluseliu50 <265648257+bluseliu50@users.noreply.github.com>

description:
  The SC8541 is a single-cell 2:1 switched-capacitor charger for USB PD
  PPS sources, with an I2C interface, a 12-bit ADC and input, bus and
  battery protections.

allOf:
  - $ref: power-supply.yaml#

properties:
  compatible:
    const: southchip,sc8541

  reg:
    maxItems: 1

  interrupts:
    maxItems: 1

required:
  - compatible
  - reg

unevaluatedProperties: false

examples:
  - |
    #include <dt-bindings/interrupt-controller/irq.h>
    i2c {
        #address-cells = <1>;
        #size-cells = <0>;

        charger@6a {
            compatible = "southchip,sc8541";
            reg = <0x6a>;
            interrupt-parent = <&tlmm>;
            interrupts = <68 IRQ_TYPE_EDGE_FALLING>;
        };
    };
```

## Documentation/devicetree/bindings/sound/foursemi,fs19xx.yaml
```yaml
# SPDX-License-Identifier: (GPL-2.0-only OR BSD-2-Clause)
%YAML 1.2
---
$id: http://devicetree.org/schemas/sound/foursemi,fs19xx.yaml#
$schema: http://devicetree.org/meta-schemas/core.yaml#

title: FourSemi FS19xx Smart Amplifier

maintainers:
  - bluseliu50 <265648257+bluseliu50@users.noreply.github.com>

description:
  The FS1958 and the FS19xx family are boosted mono class-D speaker
  amplifiers with an I2S/TDM input and voltage/current sense output.
  The board specific register setup, including the TDM slot selection,
  comes from a preset file made with FourSemi's tuning tool. One preset
  file holds a block per amplifier, selected by the I2C address.

properties:
  compatible:
    const: foursemi,fs19xx

  reg:
    maxItems: 1

  interrupts:
    maxItems: 1

  '#sound-dai-cells':
    const: 0

  vdd-supply:
    description: Regulator for the digital supply.

  reset-gpios:
    maxItems: 1
    description:
      The shutdown pin, active low.

  firmware-name:
    maxItems: 1
    description:
      Name of the preset file, "fs19xx.fsm" if absent.

required:
  - compatible
  - reg
  - '#sound-dai-cells'

allOf:
  - $ref: dai-common.yaml#

unevaluatedProperties: false

examples:
  - |
    #include <dt-bindings/gpio/gpio.h>
    i2c {
        #address-cells = <1>;
        #size-cells = <0>;

        audio-codec@34 {
            compatible = "foursemi,fs19xx";
            reg = <0x34>;
            #sound-dai-cells = <0>;
            reset-gpios = <&tlmm 128 GPIO_ACTIVE_LOW>;
            firmware-name = "qcom/sm8750/xiaomi/piano/fs19xx.fsm";
            sound-name-prefix = "Top Left";
        };
    };
```
